/ {
    chosen {
        zephyr,display = &lcd;
    };
};

&lcd {
    status = "okay";
    /* 
       Add any additional configuration your display might need.
       For example:
       compatible = "your,display-compatible";
       reg = <0x...>;
       … 
    */
};
